/dts-v1/;
/plugin/;

//This is an example overlay to re-configure the T1S PLCA schedule

//1. Remove the driver if loaded before
// rmmod lan865x_mod
//
//2. Remove overlay if added before
// rmdir /sys/kernel/config/device-tree/overlays/t1s0
//
//3. compile this file
// dtc -I dts -O dtb -o t1s0.dtbo t1s0.dtso
//
//4. create a new overlay place (only usable once)
// mkdir /sys/kernel/config/device-tree/overlays/t1s0
//
//5. make the overlay active
// cat t1s0.dtbo > /sys/kernel/config/device-tree/overlays/t1s0/dtbo
//
//6. Load the t1s driver (lan865x_mod.ko)
// insmod/modprobe

&t1s0 {
	plca-enable = /bits/ 8 <1>;
	plca-node-id = /bits/ 8 <1>; /* PLCA node id range: 0 to 254 */
	plca-node-count = /bits/ 8 <8>; /* PLCA node count range: 1 to 255 */
};
