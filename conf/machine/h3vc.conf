## conf/machine/h3vc.conf
```bitbake
#@TYPE: Machine
#@NAME: H3VC2 machine
#@DESCRIPTION: Machine configuration for running H3ULCB

SOC_FAMILY = "r8a7795"

DEFAULTTUNE ?= "cortexa57-cortexa53"
require conf/machine/include/tune-cortexa57-cortexa53.inc
require conf/machine/include/${SOC_FAMILY}.inc

# 32BIT package install (default is disable)
# This variables can be used only in multilib.
USE_32BIT_PKGS ?= "0"
USE_32BIT_WAYLAND ?= "0"
USE_32BIT_MMP ?= "0"

MACHINE_FEATURES = ""

KERNEL_IMAGETYPE = "Image"
IMAGE_FSTYPES_append = " tar.bz2 ext4"

SERIAL_CONSOLE = "115200 ttySC0"

# Configuration for kernel
PREFERRED_PROVIDER_virtual/kernel = "linux-renesas"
KERNEL_DEVICETREE = " \
    renesas/r8a7795-h3vc2.dtb \
    renesas/r8a7795-h3vc3.dtb \
"

# Configuration for ARM Trusted Firmware
EXTRA_IMAGEDEPENDS += " arm-trusted-firmware optee-os"

# u-boot
#PREFERRED_VERSION_u-boot = "v2015.04%"
EXTRA_IMAGEDEPENDS += " u-boot"
#UBOOT_MACHINE = "h3vc2_defconfig"

PREFERRED_VERSION_u-boot = "v2018.09%"
UBOOT_CONFIG ??= "h3vc2 h3vc3"
UBOOT_CONFIG[h3vc2] = "h3vc2_defconfig"
UBOOT_CONFIG[h3vc3] = "h3vc3_defconfig"

# Mini Monitor
EXTRA_IMAGEDEPENDS += " mini-monitor"


# libdrm
PREFERRED_VERSION_libdrm = "2.4.85"

# Add variable to Build Configuration in build log
BUILDCFG_VARS_append = " SOC_FAMILY"

MACHINEOVERRIDES .= ":h3vc"

# U-boot/IPL option for H3 (SoC: r8a7795)
# For H3 SiP DDR 4GiB (1GiB x 4ch)
H3_OPTION = "0"

DISTRO_FEATURES_remove = "surroundview "
DISTRO_FEATURES_remove = "opencv-sdk"

# Command using to build kernel-module-gles
HOSTTOOLS += "sync"
```

## meta-rcar-gen4/conf/layer.conf
```bitbake
BBPATH .= ":${LAYERDIR}"

# We have recipes-* directories, add to BBFILES
BBFILES += "${LAYERDIR}/recipes-*/*/*.bb \
    ${LAYERDIR}/recipes-*/*/*.bbappend"

BBFILE_COLLECTIONS += "rcar-vc4"
BBFILE_PATTERN_rcar-vc4 = "^${LAYERDIR}/"
BBFILE_PRIORITY_rcar-vc4 = "7"
LAYERSERIES_COMPAT_rcar-vc4 = "dunfell"

LAYERDEPENDS_rcar-vc4 = "core \
                         openembedded-layer \
                         networking-layer \
                         filesystems-layer \
                         meta-python \
                         rcar-gateway"
```
